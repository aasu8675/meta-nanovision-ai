## conf/layer.conf
```bitbake
BBPATH .= ":${LAYERDIR}"
BBFILES += " \
    ${LAYERDIR}/recipes-*/*/*.bb \
    ${LAYERDIR}/recipes-*/*/*.bbappend \
"

BBFILE_COLLECTIONS += "nano"
BBFILE_PATTERN_nano = "^${LAYERDIR}/"
BBFILE_PRIORITY_nano = "13"

LAYERVERSION_nano = "1"

LAYERDEPENDS_nano = "core"

LAYERSERIES_COMPAT_nano = "dunfell"
```
